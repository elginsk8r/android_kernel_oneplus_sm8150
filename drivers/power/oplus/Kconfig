## drivers/power/oplus/Kconfig
```kconfig
config OPLUS_CHARGER
	bool "OPLUS charging system"
	depends on I2C
	select REGMAP_I2C
	help
	  Say Y here to enable OPLUS charging system support

config OPLUS_CHARGER_MTK
	bool "OPLUS charger on MTK"
	depends on OPLUS_CHARGER
	help
	  Say Y here to declare charging system is on MTK

config OPLUS_SM8150R_CHARGER
	bool "OPLUS SM8150 charger driver"
	depends on MFD_SPMI_PMIC
	help
	  Enables support for the oplus charging framework

config OPLUS_WPC_INTERFACE_ENABLE
	bool "OPLUS WPC INTERFACE ENABLE"
	depends on MFD_SPMI_PMIC
	help
	  Say Y to include support

config OPLUS_SHORT_C_BATT_CHECK
	bool "OPLUS batt short "
	help
	  Say Y here to declare OPLUS batt short

config OPLUS_STANDARD_BATTERY_CHECK_ADC
	bool "OPLUS Official Standard Battery check by ADC"
	help
	  Say Y here to support Official Standard Battery check by ADC

config OPLUS_SHORT_IC_CHECK
	bool "OPLUS short ic"
	help
	  Say Y here to declare OPLUS batt short

config OPLUS_SHORT_HW_CHECK
	bool "OPLUS batt HW SHORT "
	help
	  Say Y here to declare charging system is on MTK

config OPLUS_SHORT_USERSPACE
	bool "OPLUS batt userspace"
	help
	  Say Y to include support

config OPLUS_CHIP_SOC_NODE
	bool "OPLUS chip soc node"
	help
	  Say Y to include support

config OPLUS_CHARGER_OPTIGA
	bool "OPLUS OPTIGA soc node"
	help
	  Say Y to include support

config OPLUS_CALL_MODE_SUPPORT
	bool "OPLUS call mode support"
	help
	  Say Y to include support

config OPLUS_SMART_CHARGER_SUPPORT
	bool "OPLUS smart charger support"
	help
	  Say Y to include support

config OPLUS_RTC_DET_SUPPORT
	bool "OPLUS RTC DET SUPPORT"
	depends on MFD_SPMI_PMIC
	help
	  Say Y to include support

config OPLUS_CHECK_CHARGERID_VOLT
	bool "OPLUS CHECK CHARGERID VOLT"
	depends on MFD_SPMI_PMIC
	help
	  Say Y to include support

config OPLUS_SHIP_MODE_SUPPORT
	bool "OPLUS_SHIP_MODE_SUPPORT"
	depends on MFD_SPMI_PMIC
	help
	  Say Y to include support

config OPLUS_SMOOTH_SOC
	bool "OPLUS SMOOTH SOC "
	help
	  Say Y to include support
```

## drivers/soc/oplus/Kconfig
```kconfig
source "drivers/soc/oplus/sensor/Kconfig"
source "drivers/soc/oplus/system/Kconfig"
```

## drivers/soc/oplus/system/Kconfig
```kconfig
# SPDX-License-Identifier: GPL-2.0-only
# Copyright (C) 2018-2020 Oplus. All rights reserved.

config OPLUS_SYSTEM_KERNEL
  bool "config oplus system feature "
  default y
  help
	define this config to add oplus sytstem kernel feature

choice
	prompt "OPLUS platform type"
	depends on OPLUS_SYSTEM_KERNEL
	default OPLUS_SYSTEM_KERNEL_GKI

config OPLUS_SYSTEM_KERNEL_QCOM
	bool "Qualcomm"

config OPLUS_SYSTEM_KERNEL_MTK
	bool "MediaTek"

config OPLUS_SYSTEM_KERNEL_GKI
	bool "Generic"

endchoice

config OPLUS_ARCH_FILE
  bool "for build directory oplus"
  ---help---
  say Y to buid in

config OPLUS_COMMON_SOFT
  bool "config oplus common software"
  select OPLUS_ARCH_FILE
  help
  define this config to get project verion from sharemem.
  Maybe this value is from CDT or dynamic identify by hardware
  id.

config OPLUS_DEVICE_IFNO
  bool "config oplus devinfo"
  select OPLUS_ARCH_FILE
  help
	define this config to compile devinfo.c for device register

config OPLUS_FEATURE_DETAILHEAD
  tristate "config detail kmsg"
    help
        define this config to add cpu number and current id and current comm to kmsg

config OPLUS_FEATURE_OPROJECT
  tristate "config oplus project info for kernel"
  default n
  help
    define this config to define oplus project

config OPLUS_FEATURE_PROJECTINFO
  tristate "config oplus common software"
  default y
  help
	define this config to get project verion from sharemem.
	Maybe this value is from CDT or dynamic identify by hardware
	id.
```
